## Guardian_DHT20_Prj/components/AT_HOST/Kconfig
```kconfig
menu "AT_HOST_Setup"
    config AT_HOST_Enable
        bool "Enable AT_HOST_communcation."
        depends on TOOLBOX_ENABLED

    if AT_HOST_Enable
        config AT_command_set_selection
            int "AT_command_set_selection"
            default 1
            help 
                "AT_cmd_init with The first instruction set or the second instruction set"
    endif
endmenu
```

## Guardian_DHT20_Prj_b/uart_async_rxtxtasks/components/toolbox/Kconfig
```kconfig
menu "TOOLBOX SETUP"
    config TOOLBOX_ENABLED
        bool "Enable Toolbox functions"

    if TOOLBOX_ENABLED
        config ENABLE_I2C
            bool "Enable I2C Bus communication"
            if ENABLE_I2C
                config I2C_PORT_NUM
                    int "I2C Master Port"
                    default 0
                config I2C_GPIO_SCL
                    int "GPIO For I2C SCL"
                    default 5
                config I2C_GPIO_SDA
                    int "GPIO For I2C SDA"
                    default 4
                config I2C_GPIO_SCL_PULLUP
                    bool "Enable SCL Pullup resistor"
                    default false
                config I2C_GPIO_SDA_PULLUP
                    bool "Enable SDA Pullup resistor"
                    default false
                config I2C_MASTER_FREQUENCY
                    int "I2C Clock frequency"
                    default 400000
                config I2C_BUS_TIMEOUT
                    int "Wait for response (ms)"
                    default 200
            endif
        config ENABLE_AT_HOST_UART
            bool "Enable AT_HOST_UART communication"
            if ENABLE_AT_HOST_UART
                config  AT_HOST_UART_PORT_NUM
                    int "UART Port"
                    default 1 
                config AT_HOST_name
                    string "UART Name"
                    default "UART"
                config AT_HOST_UART_BAUD_RATE
                    int "Baud Rate"
                    default 115200
                config AT_HOST_UART_DATA_BITS
                    hex "Data Bits"
                    default 0x3
                config AT_HOST_UART_DATA_PARITY
                    hex "Parity"
                    default 0x0
                config AT_HOST_UART_DATA_STOP_BITS
                    hex "Stop Bits"
                    default 0x1
                config AT_HOST_UART_DATA_FLOW_CONTROL
                    hex "Flow Control"
                    default 0x0
                config AT_HOST_UART_RX_PIN
                    int "RX Pin"
                    default 3
                config AT_HOST_UART_TX_PIN
                    int "TX Pin"
                    default 1 
                config AT_HOST_UART_RX_BUFFER_SIZE
                    int "RX Buffer Size"
                    default 256
                config AT_HOST_UART_TX_BUFFER_SIZE
                    int "TX Buffer Size"
                    default 256
                config AT_HOST_UART_RX_TIMEOUT
                    int "RX Timeout (ms)"
                    default 100
                config AT_HOST_UART_TX_TIMEOUT
                    int "TX Timeout (ms)"
                    default 100
                config AT_HOST_UART_RX_QUEUE_SIZE
                    int "RX Queue Size"
                    default 10
                config AT_HOST_UART_TX_QUEUE_SIZE
                    int "TX Queue Size"
                    default 10
            endif
    endif
endmenu
```
